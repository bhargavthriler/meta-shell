## conf/layer.conf
```bitbake
# We have a conf and classes directory, add to BBPATH
BBPATH .= ":${LAYERDIR}"

# We have recipes-* directories, add to BBFILES
BBFILES += "${LAYERDIR}/recipes-*/*/*.bb \
            ${LAYERDIR}/recipes-*/*/*.bbappend"

BBFILE_COLLECTIONS += "meta-shell"
BBFILE_PATTERN_meta-shell = "^${LAYERDIR}/"
BBFILE_PRIORITY_meta-shell = "10"

LAYERDEPENDS_meta-shell = "core"
LAYERSERIES_COMPAT_meta-shell = "warrior"
ENABLE_UART = "1"
RPI_USE_U_BOOT = "1"
IMAGE_ROOTFS_EXTRA_SPACE = "5242880"
```
